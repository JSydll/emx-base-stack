## sources/boards/meta-multiboot-update-raspberrypi/conf/layer.conf
```bitbake
# We have a conf and classes directory, add to BBPATH
BBPATH .= ":${LAYERDIR}"

# We have recipes-* directories, add to BBFILES
BBFILES += "${LAYERDIR}/recipes-*/*/*.bb \
            ${LAYERDIR}/recipes-*/*/*.bbappend"

BBFILE_COLLECTIONS += "meta-multiboot-update-raspberrypi"
BBFILE_PATTERN_meta-multiboot-update-raspberrypi = "^${LAYERDIR}/"
BBFILE_PRIORITY_meta-multiboot-update-raspberrypi = "10"

LAYERDEPENDS_meta-multiboot-update-raspberrypi = "core"
LAYERSERIES_COMPAT_meta-multiboot-update-raspberrypi = "dunfell"
```

## sources/boards/meta-qemu-multiboot-update/conf/machine/qemux86-64-extra.conf
```bitbake
# System capabilities
MACHINE_FEATURES_append = " pcbios efi"
EXTRA_IMAGEDEPENDS += "ovmf"

DISTRO_FEATURES_append = " systemd"
VIRTUAL-RUNTIME_init_manager = "systemd"
DISTRO_FEATURES_BACKFILL_CONSIDERED = "sysvinit"
VIRTUAL-RUNTIME_initscripts = ""

# Bootloader settings
PREFERRED_RPROVIDER_virtual-grub-bootconf = "rauc-qemu-grubconf"
```

## sources/boards/qemu/meta-qemu-multiboot-update/conf/layer.conf
```bitbake
# We have a conf and classes directory, add to BBPATH
BBPATH .= ":${LAYERDIR}"

# We have recipes-* directories, add to BBFILES
BBFILES += "${LAYERDIR}/recipes-*/*/*.bb \
            ${LAYERDIR}/recipes-*/*/*.bbappend"

BBFILE_COLLECTIONS += "meta-qemu-multiboot-update"
BBFILE_PATTERN_meta-qemu-multiboot-update = "^${LAYERDIR}/"
BBFILE_PRIORITY_meta-qemu-multiboot-update = "10"

LAYERDEPENDS_meta-qemu-multiboot-update = "core"
LAYERSERIES_COMPAT_meta-qemu-multiboot-update = "kirkstone"
```

## sources/boards/qemu/meta-qemu-multiboot-update/conf/machine/qemux86-64-extra.conf
```bitbake
# System capabilities
MACHINE_FEATURES:append = " pcbios efi"
EXTRA_IMAGEDEPENDS += "ovmf"

DISTRO_FEATURES:append = " systemd"
VIRTUAL-RUNTIME_init_manager = "systemd"
DISTRO_FEATURES_BACKFILL_CONSIDERED = "sysvinit"
VIRTUAL-RUNTIME_initscripts = ""

# Memory and partition table properties
STORAGE_TYPE = "sda"
PTABLE_TYPE = "gpt"

# Bootloader settings
PREFERRED_PROVIDER_virtual/bootloader = "grub"
PREFERRED_RPROVIDER_virtual-grub-bootconf = "rauc-grubconf"

ENABLE_DUAL_BOOTLOADER = "yes"

# Kernel features
KERNEL_EXTRA_FEATURES += "features/overlayfs/overlayfs.scc"

# Image features
IMAGE_INSTALL:append = " \
    kernel-image \
    kernel-modules \
"
```

## sources/boards/raspberrypi/meta-raspberrypi-multiboot-update/conf/layer.conf
```bitbake
# We have a conf and classes directory, add to BBPATH
BBPATH .= ":${LAYERDIR}"

# We have recipes-* directories, add to BBFILES
BBFILES += "${LAYERDIR}/recipes-*/*/*.bb \
            ${LAYERDIR}/recipes-*/*/*.bbappend"

BBFILE_COLLECTIONS += "meta-raspberrypi-multiboot-update"
BBFILE_PATTERN_meta-raspberrypi-multiboot-update = "^${LAYERDIR}/"
BBFILE_PRIORITY_meta-raspberrypi-multiboot-update = "10"

LAYERDEPENDS_meta-raspberrypi-multiboot-update = "core raspberrypi"
LAYERSERIES_COMPAT_meta-raspberrypi-multiboot-update = "kirkstone"
```

## sources/boards/raspberrypi/meta-raspberrypi-multiboot-update/conf/machine/raspberrypi-common.inc
```bitbake
# System capabilities
ENABLE_UART = "1"
DISABLE_SPLASH = "1"
DISABLE_RPI_BOOT_LOGO = "1"

DISTRO_FEATURES:append = " systemd"
VIRTUAL-RUNTIME_init_manager = "systemd"
DISTRO_FEATURES_BACKFILL_CONSIDERED = "sysvinit"
VIRTUAL-RUNTIME_initscripts = ""

# Memory and partition table properties
STORAGE_TYPE="mmc"
MMC_BLOCK_DEVICE="mmcblk0"
PTABLE_TYPE = "msdos"

# Bootloader settings
RPI_USE_U_BOOT = "1"
PREFERRED_PROVIDER_virtual/bootloader = "u-boot"
PREFERRED_RPROVIDER_u-boot-default-env = "libubootenv"

# Bootloader files handling
# Note: This will only work if the rpi-bootloader-files are deployed!

# Set of bootloader files
RPI_BOOTLOADER_FILES = "${BOOTFILES_DIR_NAME}/* boot.scr u-boot.bin"

# Remove from IMAGE_BOOT_FILES (as these can then be used with wic's 
# bootimg-partition to create kernel partitions), also accounting for 
# renaming of u-boot.bin.
IMAGE_BOOT_FILES:remove = "${RPI_BOOTLOADER_FILES};${SDIMG_KERNELIMAGE}" 

# The sdcard_image-rpi.bbclass uses a slight hack to have u-boot as bootloader: It stores u-boot.bin
# as ${SDIMG_KERNELIMAGE} (board-specific kernel image name) so no changes in config.txt are needed.
# But we set the kernel name explicit to make this more transparent.
RPI_EXTRA_CONFIG:append = " \n# Enforce u-boot as 4th-stage bootloader \nkernel=u-boot.bin \n"

# Image features
IMAGE_INSTALL:append = " \
    linux-firmware-bcm43430 \
    i2c-tools \
"

# Rotate the display for use with 7' LCD
DISPLAY_ROTATE = "2"
```

## sources/meta-custom/conf/layer.conf
```bitbake
# We have a conf and classes directory, add to BBPATH
BBPATH .= ":${LAYERDIR}"

# We have recipes-* directories, add to BBFILES
BBFILES += "${LAYERDIR}/recipes-*/*/*.bb \
            ${LAYERDIR}/recipes-*/*/*.bbappend"

BBFILE_COLLECTIONS += "meta-custom"
BBFILE_PATTERN_meta-custom = "^${LAYERDIR}/"
BBFILE_PRIORITY_meta-custom = "40"

LAYERDEPENDS_meta-custom = "core meta-multiboot-update meta-common-configs"
LAYERSERIES_COMPAT_meta-custom = "dunfell"
```

## sources/meta-multiboot-update-bsp/conf/layer.conf
```bitbake
# We have a conf and classes directory, add to BBPATH
BBPATH .= ":${LAYERDIR}"

# We have recipes-* directories, add to BBFILES
BBFILES += "${LAYERDIR}/recipes-*/**/*.bb \
            ${LAYERDIR}/recipes-*/**/*.bbappend"

BBFILE_COLLECTIONS += "meta-multiboot-update-bsp"
BBFILE_PATTERN_meta-multiboot-update-bsp = "^${LAYERDIR}/"
BBFILE_PRIORITY_meta-multiboot-update-bsp = "10"

LAYERDEPENDS_meta-multiboot-update-bsp = "core"
LAYERSERIES_COMPAT_meta-multiboot-update-bsp = "dunfell"
```

## sources/meta-multiboot-update-bsp/conf/machine/raspberrypi-common.inc
```bitbake
# System capabilities
ENABLE_UART = "1"
DISABLE_SPLASH = "1"
DISABLE_RPI_BOOT_LOGO = "1"

DISTRO_FEATURES_append = " systemd"
VIRTUAL-RUNTIME_init_manager = "systemd"
DISTRO_FEATURES_BACKFILL_CONSIDERED = "sysvinit"
VIRTUAL-RUNTIME_initscripts = ""

# Storage and partitioning
STORAGE_TYPE = "mmc"
MMC_BLOCK_DEVICE = "/dev/mmcblk0"
PTABLE_TYPE = "msdos"

# u-boot settings
RPI_USE_U_BOOT = "1"
PREFERRED_PROVIDER_virtual/bootloader = "u-boot"
PREFERRED_RPROVIDER_u-boot-default-env = "libubootenv"

# The sdcard_image-rpi.bbclass uses a slight hack to have u-boot as bootloader: It stores u-boot.bin
# as ${SDIMG_KERNELIMAGE} (board-specific kernel image name) so no changes in config.txt are needed.
# But we set the kernel name explicit to make this more transparent.
RPI_EXTRA_CONFIG_append = " \n# Enforce u-boot as 4th-stage bootloader \nkernel=u-boot.bin \n"

# Extensions
IMAGE_CLASSES_append = " bootloader-image-rpi"

# Image features
IMAGE_INSTALL_append = " linux-firmware-bcm43430 i2c-tools"
```

## sources/meta-multiboot-update-bsp/conf/machine/raspberrypi3-extra.conf
```bitbake
require raspberrypi-common.inc

# Device tree configuration
DTB_FILE_NAME = "bcm2710-rpi-3-b-plus.dtb"
```

## sources/meta-multiboot-update/conf/layer.conf
```bitbake
# We have a conf and classes directory, add to BBPATH
BBPATH .= ":${LAYERDIR}"

# We have recipes-* directories, add to BBFILES
BBFILES += "${LAYERDIR}/recipes-*/*/*.bb \
            ${LAYERDIR}/recipes-*/*/*.bbappend"

BBFILE_COLLECTIONS += "meta-multiboot-update"
BBFILE_PATTERN_meta-multiboot-update = "^${LAYERDIR}/"
BBFILE_PRIORITY_meta-multiboot-update = "20"

LAYERDEPENDS_meta-multiboot-update = "core meta-poky-extensions"
LAYERSERIES_COMPAT_meta-multiboot-update = "kirkstone"

# Defaults
PREFERRED_RPROVIDER_base-files-fstab      = "multiboot-fstab"
PREFERRED_RPROVIDER_robust-fileystem-init = "robust-filesystem-system-init"

# Common variables for the robust filesystem initialization
FS_PRE_INIT_NAME      = "pre-init"
FS_ORIGINAL_INIT_NAME = "init.orig"

# Account for the extended partitioning layout in case msdos partition tables are used
FS_PERSISTENT_PARTITION_OFFSET = "${@bb.utils.contains('PTABLE_TYPE', 'msdos', '7', '6', d)}"
```

## sources/meta-multiboot-update/conf/machine/raspberrypi3-extra.conf
```bitbake
# System capabilities
ENABLE_UART = "1"

DISTRO_FEATURES_append = " systemd"
VIRTUAL-RUNTIME_init_manager = "systemd"
DISTRO_FEATURES_BACKFILL_CONSIDERED = "sysvinit"
VIRTUAL-RUNTIME_initscripts = ""

# u-boot settings
RPI_USE_U_BOOT = "1"
PREFERRED_PROVIDER_virtual/bootloader = "u-boot"
PREFERRED_RPROVIDER_u-boot-default-env = "libubootenv"

# Image features
IMAGE_INSTALL_append = " rauc linux-firmware-bcm43430 i2c-tools"
IMAGE_FSTYPES_append = " wic ext4"
IMAGE_FSTYPES_remove = " ext3"

# Partition layout
WKS_FILE = "mmc-multiboot.wks.in"
WKS_BOOT_PART = "part /boot --source bootimg-partition --ondisk ${MMC_BLOCK_DEVICE} --fstype=vfat --label boot --active --align 4096 --size 20"
```

## sources/poky-extensions/conf/layer.conf
```bitbake
# Currently, we do not have recipes in this layer.
BBPATH .= ":${LAYERDIR}"

LAYERDEPENDS_poky-extensions = "core"
LAYERSERIES_COMPAT_poky-extensions = "dunfell"
```
